ASAP2_VERSION 1 41
/begin PROJECT myDbleTest_PC "Generated by ETAS from Project myDbleTest_PC"
/begin HEADER "" VERSION "000" PROJECT_NO ASD /end HEADER
/begin MODULE myDbleTest_PC "Generated by ETAS ASCET7 from Project: myDbleTest_PC"
/begin IF_DATA E_TARGET
 /begin SOURCE "Task0" 3 /* period */ 10 QP_BLOB 1 /end SOURCE
 /begin TP_BLOB /* programm id */ 176172945 /* target id */ 7 0 2 0 /end TP_BLOB
/end IF_DATA
/begin MOD_PAR "" VERSION "000" ADDR_EPK 0x0 EPK "" SUPPLIER "ETAS GmbH" CUSTOMER "xxx" CUSTOMER_NO "000" USER "xxx" PHONE_NO "000" ECU "PC" CPU_TYPE "PCx86" NO_OF_INTERFACES 1 /end MOD_PAR
/begin MOD_COMMON "Common definitions" BYTE_ORDER MSB_LAST ALIGNMENT_BYTE 1 ALIGNMENT_WORD 2 ALIGNMENT_LONG 4 ALIGNMENT_FLOAT32_IEEE 4 ALIGNMENT_FLOAT64_IEEE 8 /end MOD_COMMON
/begin MEASUREMENT Lrrr.myDbleTest.tester.v "" FLOAT32_IEEE esdl_ident 1 100.0 -3.4028234663852886E+38 3.4028234663852886E+38 ECU_ADDRESS 0x0 MATRIX_DIM 2 1 1 /end MEASUREMENT
/begin CHARACTERISTIC Lrrr.myDbleTest.tester.c "" VALUE /* ecu address */ 0x0 /* record layout */ STANDARD_VALUE_R32 /* max diff value */ 0.0 esdl_ident -3.4028234663852886E+38 3.4028234663852886E+38 /end CHARACTERISTIC
/begin MEASUREMENT Lrrr.myDbleTest.tester.v_2 "" FLOAT32_IEEE esdl_ident 1 100.0 -3.4028234663852886E+38 3.4028234663852886E+38 ECU_ADDRESS 0x0 /end MEASUREMENT
/begin MEASUREMENT Lrrr.myDbleTest.tester.v_4 "" FLOAT32_IEEE esdl_ident 1 100.0 -3.4028234663852886E+38 3.4028234663852886E+38 ECU_ADDRESS 0x0 /end MEASUREMENT
/begin COMPU_METHOD esdl_ident "" RAT_FUNC /* format */ "%12.4" /* unit */ "" /* coeffs */ COEFFS 0 1 0 0 0 1 /end COMPU_METHOD
/begin FUNCTION Lrrr.myDbleTest "" /begin SUB_FUNCTION Lrrr.myDbleTest.tester /end SUB_FUNCTION /end FUNCTION
/begin FUNCTION Lrrr.myDbleTest.tester "" /begin DEF_CHARACTERISTIC Lrrr.myDbleTest.tester.c /end DEF_CHARACTERISTIC
 /begin LOC_MEASUREMENT Lrrr.myDbleTest.tester.v Lrrr.myDbleTest.tester.v_2 Lrrr.myDbleTest.tester.v_4 /end LOC_MEASUREMENT
 /begin SUB_FUNCTION Lrrr.myDbleTest.tester.Lrrr_instance /end SUB_FUNCTION
/end FUNCTION
/begin FUNCTION Lrrr.myDbleTest.tester.Lrrr_instance "" /end FUNCTION
/begin RECORD_LAYOUT STANDARD_VALUE_R32 /* value */ FNC_VALUES 1 FLOAT32_IEEE COLUMN_DIR DIRECT /end RECORD_LAYOUT
/begin GROUP Lrrr.myDbleTest "" ROOT /begin SUB_GROUP Lrrr.myDbleTest.tester /end SUB_GROUP /end GROUP
/begin GROUP Lrrr.myDbleTest.tester "" /begin REF_CHARACTERISTIC Lrrr.myDbleTest.tester.c /end REF_CHARACTERISTIC
 /begin REF_MEASUREMENT Lrrr.myDbleTest.tester.v Lrrr.myDbleTest.tester.v_2 Lrrr.myDbleTest.tester.v_4 /end REF_MEASUREMENT
 /begin SUB_GROUP Lrrr.myDbleTest.tester.Lrrr_instance /end SUB_GROUP
/end GROUP
/begin GROUP Lrrr.myDbleTest.tester.Lrrr_instance "" /end GROUP
/end MODULE
/end PROJECT
